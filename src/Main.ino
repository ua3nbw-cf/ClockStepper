// Clock Stepper
// -*- mode: C++ -*-
//
// Copyright (C) 2019 ua3nbw

//Энкодер на пинах А0, А1. Используется внутренняя подтяжка.
//кнопка энкодера на D3
//11-dinamic // A4, A5 - I2C PCF2129 //

//#include <Squawk.h>
#include <FaBoRTC_PCF2129.h>
#include <AccelStepper.h>
#include <MultiStepper.h>
#include "LowPower.h" // подключение библиотеки для энергосбережения
#include "Encoder.h"
#include <PCM.h>

const unsigned char sample[] PROGMEM = {
	130, 127, 126, 128, 128, 127, 127, 128, 128, 127, 127, 127,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 128,
};

#define COUNT_NOTES 14
int  frequences[COUNT_NOTES] = {392, 392, 392, 392, 0, 392, 392, 392, 392, 0, 392, 392, 392, 392};
int  durations[COUNT_NOTES]  = {60, 60, 70, 70, 0, 60, 60, 70, 70, 0, 60, 60, 70, 70};
int  delays[COUNT_NOTES]  = {100, 100, 120, 120, 450, 100, 100, 120, 120, 450, 100, 100, 120, 120};

//noTone(11);


//tone(11, 1000, 1000);
// 	tone(11, frequences[i], durations[i]);
// #define COUNT_NOTES 14
// int  frequences[COUNT_NOTES] = {329, 392, 392, 329, 440, 392, 440, 392, 440, 392, 440, 392, 440, 493};
// int  durations[COUNT_NOTES]  = {300, 600, 300, 600, 300, 300, 300, 300, 300, 300, 300, 300, 300, 600 };
// int  delays[COUNT_NOTES]  = {300, 1200, 300, 1200, 300, 300, 300, 300, 300, 300, 300, 300, 300, 600 };
int tonePin = 11;

// A2, A3, A6, A7,  13

// EG X-Y position bed driven by 2 steppers
// Alas its not possible to build an array of these with different pins for each :-(
AccelStepper stepper1(AccelStepper::FULL4WIRE, 7, 4, 5, 6); //часы
AccelStepper stepper2(AccelStepper::FULL4WIRE,  12, 8, 9, 10); //минуты

//AccelStepper stepper1(AccelStepper::FULL4WIRE, 11, 8, 9, 10); //часы
//AccelStepper stepper2(AccelStepper::FULL4WIRE,  7, 4, 5, 6); //минуты

// Up to 10 steppers can be handled as a group by MultiStepper
MultiStepper steppers;
long positions[2]; // Array of desired stepper positions

int led = 13;

volatile boolean flag_int_PCF2129 = false;
//uint32_t ts;
int8_t i = 1;
FaBoRTC_PCF2129 faboRTC;

int old_hour;
int old_min;

void setup() {
	Serial.begin(9600); // открываем серийный порт для дебаггинга
	while (!Serial) {
		delay(1);
	}

	//delay(1000);
	Wire.begin();// A4, A5 - I2C

	Serial.println(F("Starting ..."));
	Serial.println("Checking I2C device...");

	if (faboRTC.searchDevice()) {
		Serial.println("configuring FaBo RTC I2C Brick");
		faboRTC.configure();
	}
	else {
		Serial.println("device not found");
		while (1);
	}

	//Serial.println("set time");
	//faboRTC.setTime(12, 59, 0);
	//faboRTC.set1_sec(); //Second interrupt  enabled (default Minute interrupt enabled)
	//faboRTC.set24mode(); //Set to 24 hour mode (default Set to 12 hour mode)
	faboRTC.set12mode();

	pinMode(led, OUTPUT);              // порт как выход
	EncoderInit();//Инициализация энкодера

	// Configure each stepper
	stepper1.setMaxSpeed(500); stepper2.setMaxSpeed(500);

	// Then give them to MultiStepper to manage
	steppers.addStepper(stepper1); steppers.addStepper(stepper2);

	MultiStepers (360, 600); // Blocks until all are in position

	Time now = faboRTC.now();

	Serial.print("Time: "); Serial.print(now.hour()); Serial.print(":");
	Serial.print(now.minute()); Serial.print(":");
	Serial.print(now.second()); Serial.println();

	old_hour = now.hour();
	old_min = now.minute();



	//button = false;

	MultiStepers ((now.hour() * 30) + (now.minute() / 2) - 15, now.minute() * 10); //установит время с PCF2129 после reset
}

boolean flag_Dong = true;


void loop() {
	byte count = 0;    // счетчик нажатий кнопки энкодера

	// Деактивировать занятые пины и установить их в LOW.
	// Снимает напряжение с обмоток двигателя, экономя энергию (вал при это может проворачиваться под внешними нагрузками)
	stepper1.disableOutputs();  stepper2.disableOutputs(); //

	attachInterrupt(0, int_PCF2129, FALLING); // привязываем 0-е прерывание к функции int_PCF2129().
	LowPower.powerDown(SLEEP_FOREVER, ADC_OFF, BOD_OFF); // переход в режим сна

	if (flag_int_PCF2129) { //если прерывание от PCF2129


		//Serial.print("Time hour -");Serial.print("   stepper1.currentPosition -"); Serial.println(stepper1.currentPosition());
		//Serial.print("Time min -"); Serial.print("    stepper2.currentPosition -"); Serial.println(stepper2.currentPosition());
		//Serial.println(".");

		int step_hour = stepper1.currentPosition();
		int step_min = stepper2.currentPosition();


		step_min = step_min + 10;//к текущему абсолютному положение (в шагах) прибавляем минуту, в шагах это +10.

		if ( !i-- ) {
			++step_hour;
			i = 1;
		} // пропуск каждого второго прерывания SkipEverySecond

		//if ((step_min / 10 & 1) == 1) {++step_hour;} //	Проверка на чётность // пропуск каждого второго прерывания


		//Serial.print("---------------    currentPosition hour -");Serial.println(hour);
		//   if (step_min == 600) { step_min = 0; }

		step_min = (step_min == 600) ? 0 : step_min;//if (step_min == 600) { step_min = 0; }
		step_hour = (step_hour > 360) ? 0 : step_hour;//if (step_hour == 360) { step_hour = 0; }



		//MultiStepers (step_hour, step_min); //stepper1 часы, stepper2 минуты


		// Begin playback of melody.
		//Squawk.play(TheOriginalSquawk);
		//tone(11, 1000, 1000);
		// 	tone(11, frequences[i], durations[i]);
		//midi();

		for (int i = 0; i < COUNT_NOTES; i++)
		{
			tone(11, frequences[i], durations[i]);
			delay(delays[i]);
		}


		// Serial.print("Time hour -"); Serial.print("   stepper1.currentPosition -"); Serial.println(stepper1.currentPosition());
		// Serial.print("Time min -"); Serial.print("    stepper2.currentPosition -"); Serial.println(stepper2.currentPosition());
		// Serial.println(".");


		Time now = faboRTC.now();
		MultiStepers ((now.hour() * 30) + (now.minute() / 2) - 15, now.minute() * 10); //каждую минуту установит время с PCF2129

		Serial.print("Time: "); Serial.print(now.hour()); Serial.print(":");
		Serial.print(now.minute()); Serial.print(":");
		Serial.print(now.second()); Serial.println();


		Serial.print("old_hour -"); Serial.println(old_hour);
		Serial.print("old_min -"); Serial.println(old_min);

		int new_hour = now.hour();
		int new_min = now.minute();

		Serial.print("now hour -"); Serial.print(new_hour); Serial.print("   currentPosition hour -"); Serial.println(step_hour);
		Serial.print("now min -"); Serial.print(new_min); Serial.print("    currentPosition min -"); Serial.println(step_min);


		Serial.println(".");




		if (((new_min == 15) || (new_min == 30) || (new_min == 45)) && flag_Dong)
		{
			startPlayback(sample, sizeof(sample));
			delay(2000);
			stopPlayback();

		}

		if (((new_hour != old_hour)) && flag_Dong)
		{
			for (int n = 0; n < new_hour; ++n)
			{
				startPlayback(sample, sizeof(sample));
				delay(2000);
				stopPlayback();
			}
			old_hour = new_hour;
		}


		digitalWrite(led, HIGH);// индикация импульсов с PCF2129 при срабатовании прерывания
		flag_int_PCF2129 = false;


		delay(100);

		//Squawk.stop();
		digitalWrite(led, LOW);

	}

	detachInterrupt(0); // запрет прерываний
	//==================================================================================================
	if (button ) { // установка времени энкодером и запись в PCF2129 при клике кнопки энкодера
		stepper1.setMaxSpeed(360); stepper2.setMaxSpeed(360);
		detachInterrupt(1); // запрет прерываний
		for ( ; ; ) {
			static uint32_t pushmillis = 0;
			if (digitalRead(3) == LOW) // если нажата кнопка
			{
				pushmillis = millis();
				count++;
				delay(100);
			}

			if (pushmillis && millis() - pushmillis > 500)

			{
				switch (count) {
				case 1:
					//выполняется, когда count равно 1
					Serial.print("    Alarm OFF");
					attachInterrupt(1, int_click, LOW); // привязываем 1-е прерывание к функции int_click().
					break;
				case 2:
					//выполняется когда  count равно 2
					Serial.print("    Alarm ON");
					attachInterrupt(1, int_click, LOW); // привязываем 1-е прерывание к функции int_click().
					break;
				case 3:
					//выполняется когда  count равно 3
					Serial.print("    TimeSet");
					attachInterrupt(1, int_click, LOW); // привязываем 1-е прерывание к функции int_click().
					Set_Time();
					break;
				case 4:
					//выполняется когда  count равно 4
					Serial.print("    AlarmSet");
					attachInterrupt(1, int_click, LOW); // привязываем 1-е прерывание к функции int_click().
					Set_Alarm();
					break;
				case 5:
					//выполняется когда  count равно 5
					Serial.print("    DongON - DongOFF");
					flag_Dong = !flag_Dong;
					attachInterrupt(1, int_click, LOW); // привязываем 1-е прерывание к функции int_click().
					break;
				default:
					attachInterrupt(1, int_click, LOW);
					Serial.print("    default");
					break;
					// выполняется, если не выбрана ни одна альтернатива
					// default необязателен
				}

				count = 0;
				pushmillis = 0;
			}

			Serial.print("--------------------------------break -"); Serial.println(count);
			delay(100);
			if (count == 0) {break;}
		}

		// EncoderValue = old_hour;
		// TimeSet(1, 12);
		// uint8_t sethour = EncoderValue;
		// EncoderValue = old_min;
		// TimeSet(0, 59);
		// uint8_t setmin = EncoderValue;

		// Serial.print("   record hour -"); Serial.println(sethour);
		// Serial.print("    record  min -"); Serial.println(setmin);
		// Serial.println(".");

		// faboRTC.setTime(sethour, setmin, 00); // запись в PCF2129
		// delay(100);

		// stepper1.setMaxSpeed(500); stepper2.setMaxSpeed(500);
		// MultiStepers (0, 0); // Blocks until all are in position
		// Time now = faboRTC.now();
		// MultiStepers ((now.hour() * 30) + (now.minute() / 2) - 15, now.minute() * 10); //установит время с PCF2129
		//resetFunc(); //вызываем reset

	}

	button = false;
}
//-----------------------------------------------------------------------------------------------
void Set_Alarm() {
	EncoderValue = old_hour;
	TimeSet(1, 12);
	uint8_t sethour = EncoderValue;
	EncoderValue = old_min;
	TimeSet(0, 59);
	uint8_t setmin = EncoderValue;

	Serial.print("   record hour -"); Serial.println(sethour);
	Serial.print("    record  min -"); Serial.println(setmin);
	Serial.println(".");

	//faboRTC.setTime(sethour, setmin, 00); // запись в PCF2129
	delay(100);

	stepper1.setMaxSpeed(500); stepper2.setMaxSpeed(500);
	MultiStepers (0, 0); // Blocks until all are in position
	Time now = faboRTC.now();
	MultiStepers ((now.hour() * 30) + (now.minute() / 2) - 15, now.minute() * 10); //установит время с PCF2129
	//button = false;
}

//-----------------------------------------------------------------------------------------------
void AlarmSet(uint8_t posmin, uint8_t posmax) { //пределы установки минут и часов

	button = !button;  // меняем значение на противоположное
	Serial.println("--------------------set time---------------------");
	for ( ; ; ) {

		EncoderValue = (EncoderValue < posmin) ? posmin : EncoderValue;//if (EncoderValue < posmin)  { EncoderValue = posmin; }
		EncoderValue = (EncoderValue > posmax) ? posmax : EncoderValue;//if (EncoderValue > posmax)  { EncoderValue = posmax; }


		if ((EncoderValue != newpos) && !((EncoderValue < posmin) || (EncoderValue > posmax)  )) {

			Serial.print("EncoderValue --   "); Serial.println(EncoderValue);

			if (posmin) { positions[0] = (EncoderValue * 30) - 15; } //часы
			else { positions[1] = (EncoderValue * 10); } //минуты

			//delay(10);
			MultiStepers (positions[0], positions[1]);
			newpos = EncoderValue;
		}

		//delay(10);
		if (button) { break; } //выход из цикла при следующем клике
	}

}
//-----------------------------------------------------------------------------------------------
void Set_Time() {
	EncoderValue = old_hour;
	TimeSet(1, 12);
	uint8_t sethour = EncoderValue;
	EncoderValue = old_min;
	TimeSet(0, 59);
	uint8_t setmin = EncoderValue;

	Serial.print("   record hour -"); Serial.println(sethour);
	Serial.print("    record  min -"); Serial.println(setmin);
	Serial.println(".");

	faboRTC.setTime(sethour, setmin, 00); // запись в PCF2129
	delay(100);

	stepper1.setMaxSpeed(500); stepper2.setMaxSpeed(500);
	MultiStepers (0, 0); // Blocks until all are in position
	Time now = faboRTC.now();
	MultiStepers ((now.hour() * 30) + (now.minute() / 2) - 15, now.minute() * 10); //установит время с PCF2129
	//button = false;
}

//-----------------------------------------------------------------------------------------------
void TimeSet(uint8_t posmin, uint8_t posmax) { //пределы установки минут и часов

	button = !button;  // меняем значение на противоположное
	Serial.println("--------------------set time---------------------");
	for ( ; ; ) {

		EncoderValue = (EncoderValue < posmin) ? posmin : EncoderValue;//if (EncoderValue < posmin)  { EncoderValue = posmin; }
		EncoderValue = (EncoderValue > posmax) ? posmax : EncoderValue;//if (EncoderValue > posmax)  { EncoderValue = posmax; }


		if ((EncoderValue != newpos) && !((EncoderValue < posmin) || (EncoderValue > posmax)  )) {

			Serial.print("EncoderValue --   "); Serial.println(EncoderValue);

			if (posmin) { positions[0] = (EncoderValue * 30) - 15; } //часы
			else { positions[1] = (EncoderValue * 10); } //минуты

			//delay(10);
			MultiStepers (positions[0], positions[1]);
			newpos = EncoderValue;
		}

		//delay(10);
		if (button) { break; } //выход из цикла при следующем клике
	}

}

//-----------------------------------------------------------------------------------------------
void MultiStepers(uint16_t newPossHour, uint16_t newPossMin) {
	positions[0] = newPossHour;  positions[1] = newPossMin;
	steppers.moveTo(positions);
	steppers.runSpeedToPosition(); // Blocks until all are in position
	delay(1);
}


//-----------------------------------------------------------------------------------------------
void int_PCF2129() {
	flag_int_PCF2129 = true;   //

}

